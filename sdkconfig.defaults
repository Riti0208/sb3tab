## sdkconfig.defaults
```kconfig
# ESP32-P4 sb3tab / M5Stack Tab5 configuration
CONFIG_IDF_TARGET="esp32p4"
CONFIG_ESPTOOLPY_FLASHMODE_QIO=y
CONFIG_ESPTOOLPY_FLASHSIZE_16MB=y
CONFIG_ESPTOOLPY_FLASHSIZE="16MB"
CONFIG_COMPILER_CXX_EXCEPTIONS=y
# Emergency exception buffer — without it, when operator new throws bad_alloc
# the runtime can't even allocate the exception object and falls straight to
# terminate(). 4 KB lets bad_alloc propagate to our try/catch in scratch_runtime_task.
CONFIG_COMPILER_CXX_EXCEPTIONS_EMG_POOL_SIZE=4096
CONFIG_COMPILER_OPTIMIZATION_PERF=y

# PSRAM (200MHz, XIP) — match Tab5 UserDemo
CONFIG_SPIRAM=y
CONFIG_SPIRAM_MODE_HEX=y
CONFIG_SPIRAM_SPEED_200M=y
CONFIG_SPIRAM_XIP_FROM_PSRAM=y
CONFIG_SPIRAM_FLASH_LOAD_TO_PSRAM=y
CONFIG_SPIRAM_BOOT_INIT=y
CONFIG_SPIRAM_USE_MALLOC=y
CONFIG_SPIRAM_MALLOC_ALWAYSINTERNAL=16384
CONFIG_SPIRAM_MALLOC_RESERVE_INTERNAL=32768

# L2 cache — match Tab5 UserDemo (256KB, 128B line)
CONFIG_CACHE_L2_CACHE_256KB=y
CONFIG_CACHE_L2_CACHE_LINE_128B=y

# MMU 64KB pages (match Tab5 UserDemo)
CONFIG_MMU_PAGE_SIZE_64KB=y

# USB Serial/JTAG console
CONFIG_ESP_CONSOLE_USB_SERIAL_JTAG=y

# Main task stack
CONFIG_ESP_MAIN_TASK_STACK_SIZE=32768

# Allow task stacks in PSRAM
CONFIG_FREERTOS_TASK_CREATE_ALLOW_EXT_MEM=y

# RTC fast memory as heap
CONFIG_ESP_SYSTEM_ALLOW_RTC_FAST_MEM_AS_HEAP=y

# Partition table
CONFIG_PARTITION_TABLE_CUSTOM=y
CONFIG_PARTITION_TABLE_CUSTOM_FILENAME="partitions.csv"

# Required for MIPI DSI DPI + PSRAM 200MHz
CONFIG_IDF_EXPERIMENTAL_FEATURES=y

# WiFi via ESP32-C6 (esp_hosted SDIO)
CONFIG_ESP_HOSTED_ENABLED=y
CONFIG_ESP_HOSTED_SDIO_HOST_INTERFACE=y
CONFIG_ESP_HOSTED_PRIV_SDIO_OPTION=y
CONFIG_ESP_HOSTED_IDF_SLAVE_TARGET="esp32c6"
CONFIG_ESP_HOSTED_SDIO_4_BIT_BUS=y
CONFIG_ESP_HOSTED_SDIO_BUS_WIDTH=4
CONFIG_ESP_HOSTED_SDIO_CLOCK_FREQ_KHZ=40000
CONFIG_ESP_HOSTED_SDIO_PIN_CMD=13
CONFIG_ESP_HOSTED_SDIO_PIN_CLK=12
CONFIG_ESP_HOSTED_SDIO_PIN_D0=11
CONFIG_ESP_HOSTED_SDIO_PIN_D1=10
CONFIG_ESP_HOSTED_SDIO_PRIV_PIN_D1_4BIT_BUS=10
CONFIG_ESP_HOSTED_SDIO_PIN_D2=9
CONFIG_ESP_HOSTED_SDIO_PIN_D3=8
CONFIG_ESP_HOSTED_SDIO_GPIO_RESET_SLAVE=15
CONFIG_ESP_HOSTED_GPIO_SLAVE_RESET_SLAVE=15
CONFIG_ESP_HOSTED_SDIO_RESET_ACTIVE_LOW=y
CONFIG_ESP_HOSTED_RESET_GPIO_ACTIVE_LOW=y
CONFIG_ESP_WIFI_REMOTE_ENABLED=y
CONFIG_ESP_WIFI_REMOTE_LIBRARY_HOSTED=y
CONFIG_SLAVE_IDF_TARGET_ESP32C6=y

# Camera (SC202CS via MIPI CSI)
CONFIG_CAMERA_SC202CS=y
CONFIG_CAMERA_SC202CS_MIPI_RAW8_1280X720_30FPS=y

# FAT long file names (required for /sd/games/<project_id>/assets/<md5>.<ext>)
CONFIG_FATFS_LFN_HEAP=y
CONFIG_FATFS_MAX_LFN=255
CONFIG_FATFS_API_ENCODING_UTF_8=y

# LVGL Tiny TTF (for Japanese game titles in menu)
CONFIG_LV_USE_TINY_TTF=y
CONFIG_LV_TINY_TTF_CACHE_GLYPH_CNT=256

# Bump LVGL's internal pool from 64KB → 128KB. Tiny TTF rasterizes
# Japanese glyphs on demand; a few menu screens worth of unique kanji
# (e.g. localised game titles loaded from /sd/games/) blow past 64KB,
# asserting in stbtt__new_active with no clean way to recover. The pool
# lives in BSS so we can't push it arbitrarily without starving the
# internal SRAM regions used by .sbss; 128KB is the sweet spot that fits
# the linker budget on ESP32-P4 while doubling the previous headroom.
CONFIG_LV_MEM_SIZE_KILOBYTES=128

# LVGL Montserrat font sizes used by ui_menu.cpp::montserrat_for()
CONFIG_LV_FONT_MONTSERRAT_14=y
CONFIG_LV_FONT_MONTSERRAT_16=y
CONFIG_LV_FONT_MONTSERRAT_18=y
CONFIG_LV_FONT_MONTSERRAT_20=y
CONFIG_LV_FONT_MONTSERRAT_24=y
CONFIG_LV_FONT_MONTSERRAT_36=y

# LVGL PNG decoder (for embedded logo + tile icons)
CONFIG_LV_USE_LODEPNG=y

# LVGL image cache (4MB) — caches decoded PNG so they're not re-decoded every
# frame during focus transitions. 0 = disabled (causes severe lag with PNG icons).
CONFIG_LV_CACHE_DEF_SIZE=4194304
CONFIG_LV_IMAGE_HEADER_CACHE_DEF_CNT=16

# Asset download speedup. Reuse one TLS connection across many GETs
# (wifi_http_session_*) and bump TCP window so each transfer ramps up faster.
CONFIG_ESP_TLS_CLIENT_SESSION_TICKETS=y
CONFIG_LWIP_TCP_SND_BUF_DEFAULT=11520
CONFIG_LWIP_TCP_WND_DEFAULT=11520
```
